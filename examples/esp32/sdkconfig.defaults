## examples/esp32/sdkconfig.defaults
```kconfig
CONFIG_COMPILER_CXX_EXCEPTIONS=n
CONFIG_COMPILER_CXX_RTTI=n
CONFIG_HEAP_TRACING_STANDALONE=y
CONFIG_SPIRAM=n
CONFIG_FREERTOS_CHECK_STACKOVERFLOW_CANARY=y
```
